## zmk/config/boards/shields/nrf52840_dongle/Kconfig.defconfig
```kconfig
if SHIELD_NRF52840_DONGLE

# Max 16 characters in keyboard name
    #config ZMK_KEYBOARD_NAME
    #    default "Corne nrf"

config ZMK_SPLIT_ROLE_CENTRAL
    default y

config ZMK_SPLIT
    default y

# Don't fetch bluetooth on dongle i guess
config BT_BAS
    default n

# Set this to the number of peripherals your dongle will have.
# For a unibody, this would be 1. If you have left and right halves, set it to 2, etc.
config ZMK_SPLIT_BLE_CENTRAL_PERIPHERALS
    default 2

# Set this to ZMK_SPLIT_BLE_CENTRAL_PERIPHERALS + your desired number of BT profiles (default is 5)
config BT_MAX_CONN
    default 5

# Set this to the same number as BT_MAX_CONN
config BT_MAX_PAIRED
    default 5

endif
```

## zmk/config/boards/shields/nrf52840_dongle/Kconfig.shield
```kconfig
# No whitespace after the comma or in the keyboard name!
config SHIELD_NRF52840_DONGLE
  def_bool $(shields_list_contains,nrf52840_dongle)
```

## zmk/config/boards/shields/nrf52840_dongle_display/Kconfig.shield
```kconfig
# No whitespace after the comma or in the keyboard name!
config SHIELD_NRF52840_DONGLE_DISPLAY
  def_bool $(shields_list_contains,nrf52840_dongle_display)
```

## zmk/config/boards/shields/unix60/Kconfig.shield
```kconfig
config SHIELD_UNIX60
    def_bool $(shields_list_contains,unix60)

CONFIG_ZMK_HID_REPORT_TYPE_NKRO=y
CONFIG_ZMK_USB_LOGGING=y
```

## zmk/config/west.yml
```yaml
manifest:
  defaults:
    #revision: v0.3.0
    revision: main
  remotes:
    - name: zmkfirmware
      url-base: https://github.com/zmkfirmware
    - name: petejohanson
      url-base: https://github.com/petejohanson
    - name: zmkfirmware-hidbattery
      url-base: https://github.com/Genteure
    - name: urob
      url-base: https://github.com/urob
    - name: mctechnology17
      url-base: https://github.com/mctechnology17
    - name: sch3fr
      url-base: https://github.com/sch3fr
    - name: charlesmst
      url-base: https://github.com/charlesmst
    - name: englmaxi
      url-base: https://github.com/englmaxi
    - name: darukutsu
      #url-base: https://github.com/darukutsu
      url-base: ""
  projects:
    - name: zmk
      remote: zmkfirmware
      import: app/west.yml
    #- name: zmk
    #  remote: zmkfirmware-hidbattery
    #  import: app/west.yml
    #  revision: feat/battery-reporting
    #- name: zmk
    #  remote: petejohanson
    #  import: app/west.yml
    #  revision: core/move-to-zephyr-4-1
    - name: zmk-helpers
      remote: urob
      path: modules/zmk/zmk-helpers
    - name: zmk-unicode
      remote: urob
      path: modules/zmk/zmk-unicode
    - name: zmk-dongle-display
      remote: englmaxi
      path: modules/zmk/zmk-dongle-display
      revision: main
    - name: zmk-dongle-display-view
      remote: mctechnology17
      path: modules/zmk/zmk-dongle-display-view
      revision: main
    # check once fixed for 4.1 release
    #- name: zmk-config
    #  remote: mctechnology17
    #  path: modules/zmk/zmk-config
    #  revision: main
    - name: zmk-config-unix60
      remote: sch3fr
      path: modules/zmk/zmk-config-unix60
      revision: master
    - name: nrf52840-dongle
      remote: darukutsu
      path: modules/zmk/nrf52840-dongle
      revision: main
    # check once fixed for 4.1 release
    - name: zephyr-ble-hid-usb-translator
      remote: charlesmst
      path: modules/zmk/zephyr-ble-hid-usb-translator
      revision: main
  self:
    path: config
```
